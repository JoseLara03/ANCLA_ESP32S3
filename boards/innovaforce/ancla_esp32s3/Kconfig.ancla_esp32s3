## boards/innovaforce/ancla_esp32s3/Kconfig.ancla_esp32s3
```kconfig
# Copyright (c) 2026 Innovaforce
# SPDX-License-Identifier: Apache-2.0

config BOARD_ANCLA_ESP32S3
	select SOC_ESP32S3_WROOM_N8R2
	select SOC_ESP32S3_PROCPU if BOARD_ANCLA_ESP32S3_ESP32S3_PROCPU
	select SOC_ESP32S3_APPCPU if BOARD_ANCLA_ESP32S3_ESP32S3_APPCPU
```

## boards/innovaforce/ancla_esp32s3/board.yml
```yaml
board:
  name: ancla_esp32s3
  full_name: Innovaforce ANCLA ESP32-S3
  vendor: innovaforce
  socs:
  - name: esp32s3
```
